#include <REGX52.H>
#include "74HC595.h"
#include "Delay.h"
#include "Timer0.h"

unsigned char animation[] = {
	0x00,0x00,0x00,0x00,0x00,0x00,0x00,0x00,
	0xFF,0x08,0x08,0x08,0xFF,0x00,0x3C,0x4A,
	0x89,0x89,0x71,0x00,0xFE,0x01,0x01,0x01,
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	0x00,0x00,0x00
};//Hello,World!
unsigned char Offset = 0;//设置动画偏移量

void main(void)
{
	_74HC595_Init();
	Timer0Init();
	
	while(1)
	{
		unsigned char i;
		//显示一帧
		for(i=0;i<8;i++)
		{
			LED_Show_column(i,animation[i+Offset]);
		}
	}
}

void Timer0_Rountine(void) interrupt 1
{
	static unsigned int count = 0;
	TL0 = 0x66;		//设置定时初值
	TH0 = 0xFC;		//设置定时初值
	count++;
	
	if(count == 100)//每0.1秒移动一帧
	{
		count = 0;
		Offset++;
		if(Offset>75){Offset = 0;}//复位
	}
}
